## components/bsp_m5core2/Kconfig
```kconfig
menu "M5CoreAnalyser BSP (M5Stack Core2) Configuration"

    config BSP_ADC1_QEMU_MIDSCALE_FALLBACK
        bool "Test-only: return mid-scale (2048) from bsp_adc1_read_raw() instead of hardware ADC reads"
        default n
        help
            The ESP32 QEMU machine does not emulate the SAR ADC (SENS) registers, so
            adc_oneshot_read() spins forever there. Enable this ONLY in test/QEMU builds
            (test_app/sdkconfig.defaults). When enabled, bsp_adc1_read_raw() always returns
            2048 without touching hardware and bsp_adc1_uses_mock_fallback() returns true.
            Production firmware keeps this disabled so every ADC read uses adc_oneshot_read()
            and failures are propagated to the caller, never silently replaced with mid-scale.

endmenu
```

## components/tool_core/Kconfig
```kconfig
menu "M5CoreAnalyser Tool Core Configuration"

    config ANALYSER_RUN_SELFTEST_ON_BOOT
        bool "Run registered tool_core self-tests automatically during tool_core_init()"
        default n
        help
            When enabled, tool_core_init() executes tool_core_run_selftests() at startup
            and logs pass/fail results before launching the UI shell. Disabled by default
            so normal boot is never delayed or disrupted.

endmenu
```

## test_app/sdkconfig.defaults
```kconfig
CONFIG_IDF_TARGET="esp32"
CONFIG_ESP_DEFAULT_CPU_FREQ_MHZ_240=y
CONFIG_ESP_DEFAULT_CPU_FREQ_MHZ=240
CONFIG_ESPTOOLPY_FLASHSIZE_4MB=y
CONFIG_ESPTOOLPY_FLASHSIZE="4MB"
CONFIG_FREERTOS_HZ=1000
CONFIG_ESP_MAIN_TASK_STACK_SIZE=8192
CONFIG_UNITY_ENABLE_FLOAT=y
CONFIG_UNITY_ENABLE_DOUBLE=y
CONFIG_UNITY_ENABLE_64BIT=y
CONFIG_UNITY_ENABLE_IDF_TEST_RUNNER=y

# LVGL Configuration for tool_core & ui_shell tests
CONFIG_LV_CONF_SKIP=y
CONFIG_LV_COLOR_DEPTH_16=y
CONFIG_LV_MEM_SIZE_KILOBYTES=64
CONFIG_LV_FONT_MONTSERRAT_12=y
CONFIG_LV_FONT_MONTSERRAT_14=y
CONFIG_LV_FONT_MONTSERRAT_16=y
CONFIG_LV_FONT_MONTSERRAT_20=y
CONFIG_LV_FONT_MONTSERRAT_24=y
CONFIG_LV_FONT_MONTSERRAT_28=y
CONFIG_LV_BUILD_EXAMPLES=n
```
